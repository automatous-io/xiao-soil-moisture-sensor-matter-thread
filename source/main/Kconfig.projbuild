## source/main/Kconfig.projbuild
```kconfig
menu "Soil Sensor Configuration"

    config SOIL_SAMPLE_INTERVAL_SECONDS
        int "Soil sample interval (seconds)"
        default 900
        range 60 86400
        help
            How often the firmware wakes to sample the soil probe and battery.
            Sampling is local (no radio); the reading is only reported over
            Thread when it changes by at least the report delta.

    config SOIL_REPORT_DELTA_PERCENT
        int "Report delta (percent)"
        default 1
        range 1 20
        help
            Minimum change in soil moisture percent before the Matter
            attribute is updated (and therefore reported to subscribers).

    config SOIL_EXCITATION_SETTLE_MS
        int "Probe excitation settle time (ms)"
        default 300
        help
            Delay between enabling the 200 kHz excitation PWM and the first
            ADC read, letting the probe's RC filter settle.

    config SOIL_CAL_DEFAULT_DRY_MV
        int "Default dry calibration (mV)"
        default 2750
        help
            Probe output in millivolts in dry air. Overridden by button
            calibration (triple press), which persists to NVS.

    config SOIL_CAL_DEFAULT_WET_MV
        int "Default wet calibration (mV)"
        default 1200
        help
            Probe output in millivolts in water. Overridden by button
            calibration (triple press), which persists to NVS.

    config SOIL_BATTERY_EMPTY_MV
        int "Battery empty voltage at ADC pin (mV)"
        default 1000
        help
            ADC pin voltage that maps to 0% battery. Matches the original
            ESPHome firmware's mapping for this kit.

    config SOIL_BATTERY_FULL_MV
        int "Battery full voltage at ADC pin (mV)"
        default 1500
        help
            ADC pin voltage that maps to 100% battery.

    config SOIL_BATTERY_SAG_WARN_MV
        int "Battery sag warning threshold (mV)"
        default 60
        help
            Sag between resting and LED-loaded readings that reports charge
            level Warning and sets BatReplacementNeeded. Healthy alkalines
            sag under ~20 mV; worn cells far more.

    config SOIL_BATTERY_SAG_CRIT_MV
        int "Battery sag critical threshold (mV)"
        default 150
        help
            Sag at which charge level reports Critical.

    config SOIL_THREAD_TX_POWER_DBM
        int "Thread radio TX power (dBm)"
        default 10
        range -24 20
        help
            802.15.4 transmit power. The driver default is +20 dBm
            (~350 mA TX peaks); +10 dBm cuts peak battery draw roughly 3x
            with range to spare for a home Thread mesh.

endmenu
```

## source/sdkconfig.defaults
```kconfig
CONFIG_ESPTOOLPY_FLASHSIZE_4MB=y

#enable BT
CONFIG_BT_ENABLED=y
CONFIG_BT_NIMBLE_ENABLED=y

#disable BT connection reattempt
CONFIG_BT_NIMBLE_ENABLE_CONN_REATTEMPT=n

# Disable lwip ipv6 autoconfig
CONFIG_LWIP_IPV6_AUTOCONFIG=n

# Use a custom partition table
CONFIG_PARTITION_TABLE_CUSTOM=y
CONFIG_PARTITION_TABLE_CUSTOM_FILENAME="partitions.csv"
CONFIG_PARTITION_TABLE_FILENAME="partitions.csv"
CONFIG_PARTITION_TABLE_OFFSET=0xC000

# disable softap by default
CONFIG_ESP_WIFI_SOFTAP_SUPPORT=n
CONFIG_ENABLE_WIFI_AP=n

# Enable HKDF in mbedtls
CONFIG_MBEDTLS_HKDF_C=y

# Root node (EP0) + soil sensor (EP1)
CONFIG_ESP_MATTER_MAX_DYNAMIC_ENDPOINT_COUNT=2

# Enable OTA Requestor
CONFIG_ENABLE_OTA_REQUESTOR=y

# Button
CONFIG_BUTTON_PERIOD_TIME_MS=20

# disable groupcast cluster until verified
CONFIG_SUPPORT_GROUPCAST_CLUSTER=n

# Exclude unused clusters to optimize flash and memory usage.
# Deliberately kept enabled (not listed): POWER_SOURCE (battery reporting)
# and ICD_MANAGEMENT (LIT ICD check-in registration).
CONFIG_SUPPORT_ACCOUNT_LOGIN_CLUSTER=n
CONFIG_SUPPORT_ACTIVATED_CARBON_FILTER_MONITORING_CLUSTER=n
CONFIG_SUPPORT_AIR_QUALITY_CLUSTER=n
CONFIG_SUPPORT_APPLICATION_BASIC_CLUSTER=n
CONFIG_SUPPORT_APPLICATION_LAUNCHER_CLUSTER=n
CONFIG_SUPPORT_AUDIO_OUTPUT_CLUSTER=n
CONFIG_SUPPORT_BOOLEAN_STATE_CONFIGURATION_CLUSTER=n
CONFIG_SUPPORT_BRIDGED_DEVICE_BASIC_INFORMATION_CLUSTER=n
CONFIG_SUPPORT_CAMERA_AV_SETTINGS_USER_LEVEL_MANAGEMENT_CLUSTER=n
CONFIG_SUPPORT_CARBON_DIOXIDE_CONCENTRATION_MEASUREMENT_CLUSTER=n
CONFIG_SUPPORT_CARBON_MONOXIDE_CONCENTRATION_MEASUREMENT_CLUSTER=n
CONFIG_SUPPORT_CHANNEL_CLUSTER=n
CONFIG_SUPPORT_CHIME_CLUSTER=n
CONFIG_SUPPORT_CLOSURE_CONTROL_CLUSTER=n
CONFIG_SUPPORT_CLOSURE_DIMENSION_CLUSTER=n
CONFIG_SUPPORT_COMMISSIONER_CONTROL_CLUSTER=n
CONFIG_SUPPORT_CONTENT_LAUNCHER_CLUSTER=n
CONFIG_SUPPORT_CONTENT_CONTROL_CLUSTER=n
CONFIG_SUPPORT_CONTENT_APP_OBSERVER_CLUSTER=n
CONFIG_SUPPORT_DEVICE_ENERGY_MANAGEMENT_CLUSTER=n
CONFIG_SUPPORT_DEVICE_ENERGY_MANAGEMENT_MODE_CLUSTER=n
CONFIG_SUPPORT_DIAGNOSTIC_LOGS_CLUSTER=n
CONFIG_SUPPORT_DISHWASHER_ALARM_CLUSTER=n
CONFIG_SUPPORT_DISHWASHER_MODE_CLUSTER=n
CONFIG_SUPPORT_MICROWAVE_OVEN_MODE_CLUSTER=n
CONFIG_SUPPORT_DOOR_LOCK_CLUSTER=n
CONFIG_SUPPORT_ECOSYSTEM_INFORMATION_CLUSTER=n
CONFIG_SUPPORT_ELECTRICAL_ENERGY_MEASUREMENT_CLUSTER=n
CONFIG_SUPPORT_ELECTRICAL_POWER_MEASUREMENT_CLUSTER=n
CONFIG_SUPPORT_ENERGY_EVSE_CLUSTER=n
CONFIG_SUPPORT_ENERGY_EVSE_MODE_CLUSTER=n
CONFIG_SUPPORT_ENERGY_PREFERENCE_CLUSTER=n
CONFIG_SUPPORT_FAN_CONTROL_CLUSTER=n
CONFIG_SUPPORT_FAULT_INJECTION_CLUSTER=n
CONFIG_SUPPORT_FIXED_LABEL_CLUSTER=n
CONFIG_SUPPORT_FORMALDEHYDE_CONCENTRATION_MEASUREMENT_CLUSTER=n
CONFIG_SUPPORT_HEPA_FILTER_MONITORING_CLUSTER=n
CONFIG_SUPPORT_KEYPAD_INPUT_CLUSTER=n
CONFIG_SUPPORT_LAUNDRY_WASHER_MODE_CLUSTER=n
CONFIG_SUPPORT_LOCALIZATION_CONFIGURATION_CLUSTER=n
CONFIG_SUPPORT_LOW_POWER_CLUSTER=n
CONFIG_SUPPORT_MEDIA_INPUT_CLUSTER=n
CONFIG_SUPPORT_MEDIA_PLAYBACK_CLUSTER=n
CONFIG_SUPPORT_MICROWAVE_OVEN_CONTROL_CLUSTER=n
CONFIG_SUPPORT_MESSAGES_CLUSTER=n
CONFIG_SUPPORT_MODE_SELECT_CLUSTER=n
CONFIG_SUPPORT_NITROGEN_DIOXIDE_CONCENTRATION_MEASUREMENT_CLUSTER=n
CONFIG_SUPPORT_SAMPLE_MEI_CLUSTER=n
CONFIG_SUPPORT_OCCUPANCY_SENSING_CLUSTER=n
CONFIG_SUPPORT_POWER_TOPOLOGY_CLUSTER=n
CONFIG_SUPPORT_OPERATIONAL_STATE_CLUSTER=n
CONFIG_SUPPORT_OPERATIONAL_STATE_OVEN_CLUSTER=n
CONFIG_SUPPORT_OPERATIONAL_STATE_RVC_CLUSTER=n
CONFIG_SUPPORT_OVEN_MODE_CLUSTER=n
CONFIG_SUPPORT_OZONE_CONCENTRATION_MEASUREMENT_CLUSTER=n
CONFIG_SUPPORT_PM10_CONCENTRATION_MEASUREMENT_CLUSTER=n
CONFIG_SUPPORT_PM1_CONCENTRATION_MEASUREMENT_CLUSTER=n
CONFIG_SUPPORT_PM2_5_CONCENTRATION_MEASUREMENT_CLUSTER=n
CONFIG_SUPPORT_POWER_SOURCE_CONFIGURATION_CLUSTER=n
CONFIG_SUPPORT_PUMP_CONFIGURATION_AND_CONTROL_CLUSTER=n
CONFIG_SUPPORT_RADON_CONCENTRATION_MEASUREMENT_CLUSTER=n
CONFIG_SUPPORT_REFRIGERATOR_ALARM_CLUSTER=n
CONFIG_SUPPORT_REFRIGERATOR_AND_TEMPERATURE_CONTROLLED_CABINET_MODE_CLUSTER=n
CONFIG_SUPPORT_RVC_CLEAN_MODE_CLUSTER=n
CONFIG_SUPPORT_RVC_RUN_MODE_CLUSTER=n
CONFIG_SUPPORT_SERVICE_AREA_CLUSTER=n
CONFIG_SUPPORT_SMOKE_CO_ALARM_CLUSTER=n
CONFIG_SUPPORT_SOFTWARE_DIAGNOSTICS_CLUSTER=n
CONFIG_SUPPORT_TARGET_NAVIGATOR_CLUSTER=n
CONFIG_SUPPORT_TEMPERATURE_CONTROL_CLUSTER=n
CONFIG_SUPPORT_THERMOSTAT_CLUSTER=n
CONFIG_SUPPORT_THERMOSTAT_USER_INTERFACE_CONFIGURATION_CLUSTER=n
CONFIG_SUPPORT_THREAD_BORDER_ROUTER_MANAGEMENT_CLUSTER=n
CONFIG_SUPPORT_THREAD_NETWORK_DIRECTORY_CLUSTER=n
CONFIG_SUPPORT_TIME_FORMAT_LOCALIZATION_CLUSTER=n
CONFIG_SUPPORT_TIME_SYNCHRONIZATION_CLUSTER=n
CONFIG_SUPPORT_TIMER_CLUSTER=n
CONFIG_SUPPORT_TVOC_CONCENTRATION_MEASUREMENT_CLUSTER=n
CONFIG_SUPPORT_UNIT_TESTING_CLUSTER=n
CONFIG_SUPPORT_USER_LABEL_CLUSTER=n
CONFIG_SUPPORT_VALVE_CONFIGURATION_AND_CONTROL_CLUSTER=n
CONFIG_SUPPORT_WAKE_ON_LAN_CLUSTER=n
CONFIG_SUPPORT_LAUNDRY_WASHER_CONTROLS_CLUSTER=n
CONFIG_SUPPORT_LAUNDRY_DRYER_CONTROLS_CLUSTER=n
CONFIG_SUPPORT_WIFI_NETWORK_MANAGEMENT_CLUSTER=n
CONFIG_SUPPORT_WINDOW_COVERING_CLUSTER=n
CONFIG_SUPPORT_WATER_HEATER_MANAGEMENT_CLUSTER=n
CONFIG_SUPPORT_WATER_HEATER_MODE_CLUSTER=n
CONFIG_SUPPORT_ELECTRICAL_GRID_CONDITIONS_CLUSTER=n
CONFIG_SUPPORT_COMMODITY_PRICE_CLUSTER=n
CONFIG_SUPPORT_METER_IDENTIFICATION_CLUSTER=n
CONFIG_SUPPORT_UNIT_LOCALIZATION_CLUSTER=n
CONFIG_SUPPORT_COMMODITY_METERING_CLUSTER=n
CONFIG_SUPPORT_COMMODITY_TARIFF_CLUSTER=n
CONFIG_SUPPORT_PUSH_AV_STREAM_TRANSPORT_CLUSTER=n
CONFIG_IDF_TARGET="esp32c6"

# Project-specific CHIP configuration (vendor/product identity)
CONFIG_CHIP_PROJECT_CONFIG="main/CHIPProjectConfig.h"

# Enable OpenThread
CONFIG_OPENTHREAD_ENABLED=y
CONFIG_OPENTHREAD_SRP_CLIENT=y
CONFIG_OPENTHREAD_LOG_LEVEL_DYNAMIC=n
CONFIG_OPENTHREAD_LOG_LEVEL_NOTE=y
CONFIG_OPENTHREAD_CLI=n

# Thread device type: MTD (sleepy end device), LIT ICD - not a router.
CONFIG_OPENTHREAD_MTD=y

# LwIP config for OpenThread
CONFIG_LWIP_IPV6_NUM_ADDRESSES=8
CONFIG_LWIP_MULTICAST_PING=y

# Thread is IPv6-only; drop IPv4 to save power and flash
CONFIG_LWIP_ND6=n
CONFIG_LWIP_IPV4=n
CONFIG_DISABLE_IPV4=y

# MDNS platform
CONFIG_USE_MINIMAL_MDNS=n
CONFIG_ENABLE_EXTENDED_DISCOVERY=y

# Disable WiFi STA (Thread-only device)
CONFIG_ENABLE_WIFI_STATION=n

# BLE sleep (BLE used for commissioning only)
CONFIG_BT_LE_SLEEP_ENABLE=y
CONFIG_BT_LE_LP_CLK_SRC_MAIN_XTAL=y

# Disable external 32K crystal
CONFIG_RTC_CLK_SRC_EXT_CRYS=n

# Enable power management + light sleep.
# PM_POWER_DOWN_PERIPHERAL_IN_LIGHT_SLEEP must stay off: it breaks the
# button's GPIO wake (battery only - USB blocks light sleep).
CONFIG_PM_ENABLE=y
CONFIG_PM_DFS_INIT_AUTO=y
CONFIG_ESP_SLEEP_POWER_DOWN_FLASH=y
CONFIG_ESP_PHY_MAC_BB_PD=y

# FreeRTOS config for light sleep
CONFIG_FREERTOS_HZ=1000
CONFIG_FREERTOS_USE_TICKLESS_IDLE=y

# Enable IEEE 802.15.4 sleep
CONFIG_IEEE802154_SLEEP_ENABLE=y

# mbedTLS
CONFIG_MBEDTLS_SSL_PROTO_DTLS=y

# ICD server, LIT configuration. Idle mode 900 s matches the sample
# cadence; active threshold 5000 ms is the LIT spec minimum. Runs as SIT
# until an ICD client registers.
CONFIG_ENABLE_ICD_SERVER=y
CONFIG_ENABLE_ICD_LIT=y
CONFIG_ICD_FAST_POLL_INTERVAL_MS=500
CONFIG_ICD_SLOW_POLL_INTERVAL_MS=20000
CONFIG_ICD_IDLE_MODE_INTERVAL_SEC=900
CONFIG_ICD_ACTIVE_MODE_INTERVAL_MS=1000
CONFIG_ICD_ACTIVE_MODE_THRESHOLD_MS=5000
CONFIG_ICD_CLIENTS_SUPPORTED_PER_FABRIC=2
CONFIG_ICD_MAX_NOTIFICATION_SUBSCRIBERS=2

# Enable power save for the button (GPIO wake from light sleep)
CONFIG_GPIO_BUTTON_SUPPORT_POWER_SAVE=y

# Keep the USB-Serial/JTAG console alive: no auto light sleep while a USB
# connection is active.
CONFIG_USJ_NO_AUTO_LS_ON_CONNECTION=y

# Device identification. The example DAC provider embeds keys for PIDs
# 0x8000-0x801F only; anything else fails to link. PIDs outside that range
# need a factory partition from esp-matter's mfg_tool.
CONFIG_DEVICE_PRODUCT_ID=0x8010
```
